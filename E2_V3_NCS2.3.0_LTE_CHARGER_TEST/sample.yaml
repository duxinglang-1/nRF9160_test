## E2_V3_NCS2.3.0_LTE_CHARGER_TEST/sample.yaml
```yaml
sample:
  name: e2_v3_project
tests:
  samples.nrf9160.E2_project.nRF9160:
    build_only: true
    build_on_all: true
    platform_allow: nrf9160dk_nrf9160_ns
    integration_platforms:
      - nrf9160dk_nrf9160_ns
    tags: ci_build
```

## hello_world/build_nrf9160_pca10090ns/spm/Kconfig.modules
```kconfig
osource "D:/software/nrf9160/ncs1.2.0/nrf/Kconfig.nrf"

osource "D:/software/nrf9160/ncs1.2.0/bootloader/mcuboot/zephyr/Kconfig"

osource "D:/software/nrf9160/ncs1.2.0/nrfxlib/Kconfig.nrfxlib"
```

## nrf/samples/nrf9160/hello_world/build_nrf9160_pca10090ns/Kconfig.modules
```kconfig
osource "D:/software/nrf9160/ncs/nrf/Kconfig.nrf"

osource "D:/software/nrf9160/ncs/mcuboot/zephyr/Kconfig"

osource "D:/software/nrf9160/ncs/nrfxlib/Kconfig.nrfxlib"
```

## udp_with_psm/build_nrf9160dk_nrf9160ns/Kconfig/Kconfig.modules
```kconfig
osource "D:/software/nrf9160/ncs1.4.0/nrf/Kconfig.nrf"

osource "D:/software/nrf9160/ncs1.4.0/bootloader/mcuboot/zephyr/Kconfig"

osource "D:/software/nrf9160/ncs1.4.0/nrfxlib/Kconfig.nrfxlib"
```
